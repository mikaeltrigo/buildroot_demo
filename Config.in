## Config.in
```kconfig
source "$BR2_EXTERNAL_demo_PATH/package/xilinx_axidma/Config.in"
source "$BR2_EXTERNAL_demo_PATH/package/axidma_tests/Config.in"

source "$BR2_EXTERNAL_demo_PATH/package/fpga-control-module-qt/Config.in"
source "$BR2_EXTERNAL_demo_PATH/package/fpga-control-module/Config.in"
source "$BR2_EXTERNAL_demo_PATH/package/lua-fpgacontrol/Config.in"
source "$BR2_EXTERNAL_demo_PATH/package/lua-msleep/Config.in"
source "$BR2_EXTERNAL_demo_PATH/package/quantum/Config.in"
source "$BR2_EXTERNAL_demo_PATH/package/bridgeQuantumTCP/Config.in"
source "$BR2_EXTERNAL_demo_PATH/package/pwrt3lcdapp/Config.in"
source "$BR2_EXTERNAL_demo_PATH/package/lcdcontrol/Config.in"
source "$BR2_EXTERNAL_demo_PATH/package/soce_ptp/Config.in"
source "$BR2_EXTERNAL_demo_PATH/package/pwrt3_lua/Config.in"

source "$BR2_EXTERNAL_demo_PATH/package/linuxptpv2.0/Config.in"
```

## configs/powertime3_defconfig
```kconfig
BR2_arm=y
BR2_cortex_a9=y
BR2_ARM_ENABLE_NEON=y
BR2_ARM_ENABLE_VFP=y
BR2_DL_DIR="$(HOME)/.buildroot-dl"
BR2_CCACHE=y
BR2_TOOLCHAIN_EXTERNAL=y
BR2_TOOLCHAIN_EXTERNAL_GDB_SERVER_COPY=y
BR2_ECLIPSE_REGISTER=y
BR2_TARGET_GENERIC_HOSTNAME="swt-buildroot"
BR2_ROOTFS_DEVICE_CREATION_DYNAMIC_EUDEV=y
BR2_TARGET_GENERIC_ROOT_PASSWD="root"
BR2_TARGET_GENERIC_GETTY_PORT="ttyPS0"
BR2_TARGET_TZ_INFO=y
BR2_ROOTFS_OVERLAY="${BR2_EXTERNAL}/board/powertime3/rootfs_overlay"
BR2_ROOTFS_POST_BUILD_SCRIPT="${BR2_EXTERNAL}/board/powertime3/post-build.sh"
BR2_ROOTFS_POST_IMAGE_SCRIPT="${BR2_EXTERNAL}/board/powertime3/post-image.sh"
BR2_LINUX_KERNEL=y
BR2_LINUX_KERNEL_CUSTOM_TARBALL=y
BR2_LINUX_KERNEL_CUSTOM_TARBALL_LOCATION="$(call github,enclustra-bsp,xilinx-linux,v1.8)/linux-v1.8.tar.gz"
BR2_LINUX_KERNEL_PATCH="${BR2_EXTERNAL}/board/powertime3/kernel/patches/"
BR2_LINUX_KERNEL_USE_CUSTOM_CONFIG=y
BR2_LINUX_KERNEL_CUSTOM_CONFIG_FILE="${BR2_EXTERNAL}/board/powertime3/kernel/config/xilinx_zynq_defconfig"
BR2_LINUX_KERNEL_UIMAGE=y
BR2_LINUX_KERNEL_UIMAGE_LOADADDR="0x8000"
BR2_LINUX_KERNEL_DTS_SUPPORT=y
BR2_LINUX_KERNEL_INTREE_DTS_NAME="zynq-mars-zx2"
BR2_LINUX_KERNEL_CUSTOM_DTS_PATH="${BR2_EXTERNAL}/board/powertime3/kernel/dts/zynq-mars-zx2.dts"
BR2_PACKAGE_BUSYBOX_SHOW_OTHERS=y
BR2_PACKAGE_GDB=y
BR2_PACKAGE_EUDEV_RULES_GEN=y
BR2_PACKAGE_I2C_TOOLS=y
BR2_PACKAGE_LUA=y
BR2_PACKAGE_LUA_5_2=y
BR2_PACKAGE_LUA_READLINE=y
BR2_PACKAGE_PYTHON3=y
BR2_PACKAGE_PYTHON3_PY_ONLY=y
BR2_PACKAGE_ZEROMQ=y
BR2_PACKAGE_DROPBEAR=y
BR2_PACKAGE_ETHTOOL=y
BR2_PACKAGE_GESFTPSERVER=y
BR2_PACKAGE_IFUPDOWN=y
BR2_PACKAGE_IPERF3=y
BR2_PACKAGE_PHYTOOL=y
BR2_PACKAGE_TCPDUMP=y
BR2_PACKAGE_ATOP=y
BR2_PACKAGE_SWUPDATE=y
BR2_PACKAGE_UTIL_LINUX_HWCLOCK=y
BR2_TARGET_ROOTFS_CPIO=y
BR2_TARGET_ROOTFS_CPIO_GZIP=y
BR2_TARGET_ROOTFS_CPIO_UIMAGE=y
BR2_TARGET_ROOTFS_EXT2=y
BR2_TARGET_ROOTFS_EXT2_4=y
BR2_TARGET_UBOOT=y
BR2_TARGET_UBOOT_BUILD_SYSTEM_KCONFIG=y
BR2_TARGET_UBOOT_CUSTOM_GIT=y
BR2_TARGET_UBOOT_CUSTOM_REPO_URL="https://github.com/enclustra-bsp/xilinx-uboot.git"
BR2_TARGET_UBOOT_CUSTOM_REPO_VERSION="v1.8"
BR2_TARGET_UBOOT_PATCH="${BR2_EXTERNAL}/board/powertime3/uboot/patches/"
BR2_TARGET_UBOOT_USE_CUSTOM_CONFIG=y
BR2_TARGET_UBOOT_CUSTOM_CONFIG_FILE="${BR2_EXTERNAL}/board/powertime3/uboot/config/zynq_mars_zx2_defconfig"
# BR2_TARGET_UBOOT_FORMAT_BIN is not set
BR2_TARGET_UBOOT_FORMAT_ELF=y
BR2_TARGET_UBOOT_CUSTOM_DTS_PATH="${BR2_EXTERNAL}/board/powertime3/uboot/dts/zynq-mars-zx2.dts"
BR2_PACKAGE_HOST_DOSFSTOOLS=y
BR2_PACKAGE_HOST_GENIMAGE=y
BR2_PACKAGE_HOST_MTOOLS=y
BR2_PACKAGE_HOST_UBOOT_TOOLS_FIT_SUPPORT=y
BR2_PACKAGE_FPGA_CONTROL_MODULE_QT=y
BR2_PACKAGE_FPGA_CONTROL_MODULE=y
BR2_PACKAGE_LUA_FPGACONTROL=y
BR2_PACKAGE_LUA_MSLEEP=y
BR2_PACKAGE_QUANTUM=y
BR2_PACKAGE_BRIDGEQUANTUMTCP=y
BR2_PACKAGE_PWRT3LCDAPP=y
BR2_PACKAGE_LCDCONTROL=y
BR2_PACKAGE_SOCE_PTP=y
BR2_PACKAGE_PWRT3_LUA=y
```

## configs/zx3_eb1_defconfig
```kconfig
BR2_arm=y
BR2_cortex_a9=y
BR2_ARM_ENABLE_NEON=y
BR2_ARM_ENABLE_VFP=y
BR2_DL_DIR="$(HOME)/.buildroot-dl"
BR2_CCACHE=y
BR2_TOOLCHAIN_EXTERNAL=y
BR2_TOOLCHAIN_EXTERNAL_GDB_SERVER_COPY=y
BR2_ECLIPSE_REGISTER=y
BR2_TARGET_GENERIC_HOSTNAME="swt-buildroot"
BR2_ROOTFS_DEVICE_CREATION_DYNAMIC_EUDEV=y
BR2_TARGET_GENERIC_ROOT_PASSWD="root"
BR2_TARGET_GENERIC_GETTY_PORT="ttyPS0"
BR2_ROOTFS_OVERLAY="${BR2_EXTERNAL}/board/zx3_eb1/rootfs_overlay"
BR2_ROOTFS_POST_BUILD_SCRIPT="${BR2_EXTERNAL}/board/zx3_eb1/post-build.sh"
BR2_ROOTFS_POST_IMAGE_SCRIPT="${BR2_EXTERNAL}/board/zx3_eb1/post-image.sh"
BR2_LINUX_KERNEL=y
BR2_LINUX_KERNEL_CUSTOM_TARBALL=y
BR2_LINUX_KERNEL_CUSTOM_TARBALL_LOCATION="$(call github,enclustra-bsp,xilinx-linux,v1.7)/linux-v1.7.tar.gz"
BR2_LINUX_KERNEL_PATCH="${BR2_EXTERNAL}/board/zx3_eb1/kernel/patches/"
BR2_LINUX_KERNEL_USE_CUSTOM_CONFIG=y
BR2_LINUX_KERNEL_CUSTOM_CONFIG_FILE="${BR2_EXTERNAL}/board/zx3_eb1/kernel/config/xilinx_zynq_defconfig"
BR2_LINUX_KERNEL_UIMAGE=y
BR2_LINUX_KERNEL_UIMAGE_LOADADDR="0x8000"
BR2_LINUX_KERNEL_DTS_SUPPORT=y
BR2_LINUX_KERNEL_INTREE_DTS_NAME="zynq-mars-zx3"
BR2_LINUX_KERNEL_CUSTOM_DTS_PATH="${BR2_EXTERNAL}/board/zx3_eb1/kernel/dts/zynq-mars-zx3.dts"
BR2_PACKAGE_GDB=y
BR2_PACKAGE_EUDEV_RULES_GEN=y
BR2_PACKAGE_LUA=y
BR2_PACKAGE_LUA_5_2=y
BR2_PACKAGE_LUA_READLINE=y
BR2_PACKAGE_PYTHON3=y
BR2_PACKAGE_PYTHON3_PY_ONLY=y
BR2_PACKAGE_DROPBEAR=y
BR2_PACKAGE_ETHTOOL=y
BR2_PACKAGE_GESFTPSERVER=y
BR2_PACKAGE_PHYTOOL=y
BR2_PACKAGE_TCPDUMP=y
BR2_TARGET_ROOTFS_CPIO=y
BR2_TARGET_ROOTFS_CPIO_GZIP=y
BR2_TARGET_ROOTFS_CPIO_UIMAGE=y
BR2_TARGET_ROOTFS_EXT2=y
BR2_TARGET_ROOTFS_EXT2_4=y
BR2_TARGET_UBOOT=y
BR2_TARGET_UBOOT_BUILD_SYSTEM_KCONFIG=y
BR2_TARGET_UBOOT_CUSTOM_GIT=y
BR2_TARGET_UBOOT_CUSTOM_REPO_URL="https://github.com/enclustra-bsp/xilinx-uboot.git"
BR2_TARGET_UBOOT_CUSTOM_REPO_VERSION="v1.8"
BR2_TARGET_UBOOT_PATCH="${BR2_EXTERNAL}/board/zx3_eb1/uboot/patches/"
BR2_TARGET_UBOOT_BOARD_DEFCONFIG="zynq_mars_zx3"
# BR2_TARGET_UBOOT_FORMAT_BIN is not set
BR2_TARGET_UBOOT_FORMAT_ELF=y
BR2_PACKAGE_HOST_DOSFSTOOLS=y
BR2_PACKAGE_HOST_GENIMAGE=y
BR2_PACKAGE_HOST_MTOOLS=y
BR2_PACKAGE_HOST_UBOOT_TOOLS_FIT_SUPPORT=y
BR2_PACKAGE_LUA_FPGACONTROL=y
BR2_PACKAGE_LUA_MSLEEP=y
BR2_PACKAGE_SOCE_PTP=y
```

## package/bridgeQuantumTCP/Config.in
```kconfig
config BR2_PACKAGE_BRIDGEQUANTUMTCP
	bool "bridgequantumTCP"
	help
	  TCP Bridge app for the quantum
```

## package/fpga-control-module-qt/Config.in
```kconfig
config BR2_PACKAGE_FPGA_CONTROL_MODULE_QT
	tristate "FPGA register driver access for quantum"
	help
	  access fpga register in a protected way for quantum (0x8000000)
```

## package/fpga-control-module-qt/Kconfig
```kconfig
config FPGA_CONTROL_MODULE_QT
	tristate "FPGA register driver access for quantum"
	depends on HAS_IOMEM
	help
	  access fpga register in a protected way for quantum (0x8000000)
```

## package/fpga-control-module/Config.in
```kconfig
config BR2_PACKAGE_FPGA_CONTROL_MODULE
	tristate "FPGA register driver access"
	help
	  access fpga register in a protected way
```

## package/fpga-control-module/Kconfig
```kconfig
config FPGA_CONTROL_MODULE
	tristate "FPGA register driver access"
	depends on HAS_IOMEM
	help
	  access fpga register in a protected way
```

## package/lcdcontrol/Config.in
```kconfig
config BR2_PACKAGE_LCDCONTROL
	bool "lcdcontrol"
	help
	  LCD modules to acces external LCD Kentec320x240x16_ssd2119_SPI
```

## package/lua-fpgacontrol/Config.in
```kconfig
config BR2_PACKAGE_LUA_FPGACONTROL
	bool "lua-fpgacontrol"
	help
	  fpga control module is used to access the fpga axi driver 
```

## package/lua-msleep/Config.in
```kconfig
config BR2_PACKAGE_LUA_MSLEEP
	bool "lua-msleep"
	help
	 msleep function for lua
```

## package/pwrt3_lua/Config.in
```kconfig
config BR2_PACKAGE_PWRT3_LUA
	bool "Lua scripts"
	help
	  Installs the Lua scripts
```

## package/pwrt3lcdapp/Config.in
```kconfig
config BR2_PACKAGE_PWRT3LCDAPP
	bool "pwrt3lcdapp"
	help
	  Application powertime3 that managed the lcd and GPS
```

## package/soce_ptp/Config.in
```kconfig
config BR2_PACKAGE_SOCE_PTP
	bool "soce_ptp"
	help
	  SOCE_PTP software by SOC-E with cmake
```
